## conf/local.conf
```bitbake
# Where to store sources
DL_DIR = "/home/sources/OE/downloads"

INHERIT += " rm_work devshell "

# Make sure you have these installed
ASSUME_PROVIDED += "gdk-pixbuf-csource-native imagemagick-native librsvg-native"

# Which files do we want to parse:
BBFILES := "/home/sources/OE/openembedded/recipes/*/*.bb"
BBFILES += "/home/sources/OE/bt-overlay/recipes/*/*.bb"
BBMASK = ""

# Set the collections
COLLECTIONS = "/home/sources/OE/bt-overlay/ /home/sources/OE/openembedded/"

# Disable DropBear for now due to export restrictions
DISTRO_SSH_DAEMON = ""
DISTRO_EXTRA_RDEPENDS += "angstrom-version"
 
# What kind of images do we want?
IMAGE_FSTYPES += " tar.bz2 ext3 "

# Set TMPDIR instead of defaulting it to $pwd/tmp
TMPDIR = "/home/sources/OE/${DISTRO}-dev"

# Make use of SMP and fast disks
PARALLEL_MAKE = "-j8"
BB_NUMBER_THREADS = "8"

#tinderbox
#INHERIT += "oestats-client"
OESTATS_BUILDER      = "myname"

DISTRO = "angstrom-2008.1"
MACHINE ?= "dm365-evm"

# Uncomment this if you want BitBake to emit the log if a build fails.
BBINCLUDELOGS = "yes"

# for DEVSHELL
SCREEN_TERMCMD = 'screen -S DEVSHELL.fabio -D -m -t "$TERMWINDOWTITLE"'
SCREEN_TERMCMDRUN = '${SCREEN_TERMCMD} $SHELLCMDS'
TERMCMD = "${SCREEN_TERMCMD}"
TERMCMDRUN = "${SCREEN_TERMCMDRUN}"
```

## conf/local.conf.sample
```bitbake
# Where to store sources
DL_DIR = "${OETREE}/downloads"

INHERIT += " rm_work devshell "

# Make sure you have these installed
ASSUME_PROVIDED += "gdk-pixbuf-csource-native imagemagick-native librsvg-native"

# Which files do we want to parse:
BBFILES := "${OETREE}/openembedded/recipes/*/*.bb"
BBFILES += "${OETREE}/bt-overlay/recipes/*/*.bb"
BBMASK = ""

# Set the collections
COLLECTIONS = "${OETREE}/bt-overlay/ ${OETREE}/openembedded/"

# Disable DropBear for now due to export restrictions
DISTRO_SSH_DAEMON = ""
DISTRO_EXTRA_RDEPENDS += "angstrom-version"
 
# What kind of images do we want?
IMAGE_FSTYPES += " tar.bz2 ext3 "

# Set TMPDIR instead of defaulting it to $pwd/tmp
TMPDIR = "${OETREE}/${DISTRO}-dev"

# Make use of SMP and fast disks
PARALLEL_MAKE = "-j4"
BB_NUMBER_THREADS = "2"

#tinderbox
#INHERIT += "oestats-client"
OESTATS_BUILDER      = "myname"

DISTRO = "angstrom-2008.1"
MACHINE ?= "dm365-evm"

#preferred versions:
PREFERRED_VERSION_gstreamer = "0.10.25"
PREFERRED_VERSION_gst-plugins-base = "0.10.25"
PREFERRED_VERSION_gst-plugins-good = "0.10.16"
#PREFERRED_VERSION_gst-plugins-bad = "0.10.16"
#PREFERRED_VERSION_gst-plugins-ugly = "0.10.13"

# Uncomment this if you want BitBake to emit the log if a build fails.
BBINCLUDELOGS = "yes"

# for DEVSHELL
SCREEN_TERMCMD = 'screen -S DEVSHELL.user -D -m -t "$TERMWINDOWTITLE"'
SCREEN_TERMCMDRUN = '${SCREEN_TERMCMD} $SHELLCMDS'
TERMCMD = "${SCREEN_TERMCMD}"
TERMCMDRUN = "${SCREEN_TERMCMDRUN}"
```
